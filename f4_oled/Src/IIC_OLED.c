#include "IIC_OLED.h"
#include "stm32f4xx_hal.h"
#include <stdarg.h>

#define XLevelL		0x00
#define XLevelH		0x10
#define XLevel		((XLevelH&0x0F)*16+XLevelL)
#define Max_Column	128
#define Max_Row		64
#define	Brightness	0xCF 

#define X_WIDTH 128
#define Y_WIDTH 64

#define OLED_ADDR  0x78

const unsigned char F6x8[][6] =
{
    { 0x00, 0x00, 0x00, 0x00, 0x00, 0x00 },   // sp
    { 0x00, 0x00, 0x00, 0x2f, 0x00, 0x00 },   // !
    { 0x00, 0x00, 0x07, 0x00, 0x07, 0x00 },   // "
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    { 0x14, 0x14, 0x14, 0x14, 0x14, 0x14 }    // horiz lines
};

unsigned char F16x16[]=
{
0x08,0x08,0x08,0x38,0xC8,0x08,0x09,0x0E,0x08,0x08,0xC8,0x38,0x08,0x08,0x08,0x00,0x80,0x80,0x40,0x40,
0x20,0x11,0x0A,0x04,0x0A,0x11,0x20,0x40,0x40,0x80,0x80,0x00,/*"?",0*/

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0x20,0x5F,0x4A,0x4A,0x4A,0x4F,0x4A,0x4A,0x4A,0x5F,0x40,0x00,/*"?",3*/


};
/////////////////////////////////////////////OLED CTR///




void IIC_delay(void)
{
	uint8_t i;
	for(i=0;i<10;i++);
}

/**********************************************
//IIC Start
**********************************************/
void IIC_Start()
{
   SCL_1;		
   SDA_1;
	 IIC_delay();
   SDA_0;
	 IIC_delay();
   SCL_0;
	 IIC_delay();
}

/**********************************************
//IIC Stop
**********************************************/
void IIC_Stop()
{
 //  SCL_0;
   SDA_0;
   SCL_1;
	 IIC_delay();
   SDA_1;
}

/**********************************************
// 通过I2C总线写一个字节
**********************************************/
  void Write_IIC_Byte(unsigned char IIC_Byte)
  {
    unsigned char i;
    for(i=0;i<8;i++)             
    {
            if(IIC_Byte & 0x80)
                    SDA_1;
            else
                    SDA_0;
            SCL_1;              
            SCL_0;
            IIC_Byte<<=1;     
    }
		IIC_delay();
    SDA_1;
		IIC_delay();
    SCL_1;
    SCL_0;
  }

/*********************OLED写数据************************************/ 
void OLED_WrDat(unsigned char IIC_Data)
{
	IIC_Start();                                //地址0111 100+LSB AD0 = 0 so address = 0x78
	Write_IIC_Byte(OLED_ADDR);                   //0111100->Slave address, 0->SA0=0
	Write_IIC_Byte(0x40);			//write data
	Write_IIC_Byte(IIC_Data);
	IIC_Stop();
}
/*********************OLED写命令************************************/
void OLED_WrCmd(unsigned char IIC_Command)
{
	IIC_Start();
	Write_IIC_Byte(OLED_ADDR);            //0111100->Slave address, 0->SA0=0
	Write_IIC_Byte(0x00);			//write command
	Write_IIC_Byte(IIC_Command);
	IIC_Stop();
}
/*********************OLED 设置坐标************************************/
void OLED_Set_Pos(unsigned char x, unsigned char y) 
{ 
	OLED_WrCmd(0xb0+y);           //设置page，范围b0~b7
	OLED_WrCmd(((x&0xf0)>>4)|0x10);  //set the upper column address
       
   
	OLED_WrCmd((x&0x0f)|0x01);//set the lower column address
} 
/*********************OLED全屏************************************/
void OLED_Fill(unsigned char bmp_dat) 
{
	unsigned char y,x;
	for(y=0;y<8;y++)
	{
		OLED_WrCmd(0xb0+y);
		OLED_WrCmd(0x01);
		OLED_WrCmd(0x10);
		for(x=0;x<X_WIDTH;x++)
		OLED_WrDat(bmp_dat);
	}
}
/*********************OLED复位************************************/
void OLED_CLS(void)
{
	unsigned char y,x;
	for(y=0;y<8;y++)
	{
		OLED_WrCmd(0xb0+y);
		OLED_WrCmd(0x01);
		OLED_WrCmd(0x10);
		for(x=0;x<X_WIDTH;x++)
		OLED_WrDat(0);
	}
}
/*********************OLED初始化************************************/
void OLED_Init(void)
{

	//delay(500);//初始化之前的延时很重要！
	IIC_delay();
	
	OLED_WrCmd(0xae);//--turn off oled panel
	IIC_delay();
	OLED_WrCmd(0x00);//---set low column address
	IIC_delay();
	OLED_WrCmd(0x10);//---set high column address
	IIC_delay();
	OLED_WrCmd(0x40);//--set start line address  Set Mapping RAM Display Start Line (0x00~0x3F)
	IIC_delay();
	OLED_WrCmd(0x81);//--set contrast control register
	IIC_delay();
	OLED_WrCmd(Brightness); // Set SEG Output Current Brightness
	IIC_delay();
	OLED_WrCmd(0xa1);//--Set SEG/Column Mapping     0xa0左右反置 0xa1正常
	IIC_delay();
	OLED_WrCmd(0xc8);//Set COM/Row Scan Direction   0xc0上下反置 0xc8正常
	IIC_delay();
	OLED_WrCmd(0xa6);//--set normal display
	IIC_delay();
	OLED_WrCmd(0xa8);//--set multiplex ratio(1 to 64)
	IIC_delay();
	OLED_WrCmd(0x3f);//--1/64 duty
	IIC_delay();
	OLED_WrCmd(0xd3);//-set display offset	Shift Mapping RAM Counter (0x00~0x3F)
	IIC_delay();
	OLED_WrCmd(0x00);//-not offset
	IIC_delay();
	OLED_WrCmd(0xd5);//--set display clock divide ratio/oscillator frequency
	IIC_delay();
	OLED_WrCmd(0x80);//--set divide ratio, Set Clock as 100 Frames/Sec
	IIC_delay();
	OLED_WrCmd(0xd9);//--set pre-charge period
	IIC_delay();
	OLED_WrCmd(0xf1);//Set Pre-Charge as 15 Clocks & Discharge as 1 Clock
	IIC_delay();
	OLED_WrCmd(0xda);//--set com pins hardware configuration
	IIC_delay();
	OLED_WrCmd(0x12);
	IIC_delay();
	OLED_WrCmd(0xdb);//--set vcomh
	IIC_delay();
	OLED_WrCmd(0x40);//Set VCOM Deselect Level
	IIC_delay();
	OLED_WrCmd(0x20);//-Set Page Addressing Mode (0x00/0x01/0x02)
	IIC_delay();
	OLED_WrCmd(0x02);//
	IIC_delay();
	OLED_WrCmd(0x8d);//--set Charge Pump enable/disable
	IIC_delay();
	OLED_WrCmd(0x14);//--set(0x10) disable
	IIC_delay();
	OLED_WrCmd(0xa4);// Disable Entire Display On (0xa4/0xa5)
	IIC_delay();
	OLED_WrCmd(0xa6);// Disable Inverse Display On (0xa6/a7) 
	IIC_delay();
	OLED_WrCmd(0xaf);//--turn on oled panel
	IIC_delay();
	OLED_Fill(0x00); //初始清屏
	IIC_delay();
	OLED_Set_Pos(0,0);
} 
//=============================数字显示函数=============================
//显示5个数字的数字串
void disnum(unsigned int num,unsigned char x, unsigned char y)
{
  unsigned char number[]={"     "};
  unsigned char i,j,c;
  number[4] = num%10 ;
  number[3] = (num/10)%10 ;
  number[2] = (num/100 )%10;
  number[1] = (num/1000 )%10 ;
  number[0] = num/10000 ;
  OLED_Set_Pos(x,y);
  for(j=0;j<5;j++)
    {
      c = number[j] + 16 ;
      for(i=0;i<6;i++)  OLED_WrDat(F6x8[c][i]);
    }
}

/***************功能描述：显示6*8一组标准ASCII字符串	显示的坐标（x,y），y为页范围0～7****************/
void OLED_P6x8Str(unsigned char x, unsigned char y, char ch[])
{
	unsigned char c=0,i=0,j=0;
	while (ch[j]!='\0')
	{
		c =ch[j]-32;
		if(x>126){x=0;y++;}
		OLED_Set_Pos(x,y);
		for(i=0;i<6;i++)
		OLED_WrDat(F6x8[c][i]);
		x+=6;
		j++;
	}                                                                                                                                                                                                                                                                                            
}
static int lock=0;
//浮点型数据显示   只显示十位开始到小数点后3位
void disfloat_num(unsigned char x, unsigned char y,float num)
{
	
	if(lock!=1){
	lock =1;
	unsigned char number[]={"     "};
  unsigned char i,j,c;
	uint32_t int_num;
	uint32_t decimal;
  int_num = (int)num;
	decimal = (num - int_num)*1000;
  number[0] = int_num/10;           //十位
  number[1] = int_num%10 ;         //个位
  number[2] = '.';                 //小数点
  number[3] = decimal/100;         //小数点后一位
  number[4] = (decimal/10)%10;      //小数点后第二位
  number[5] = decimal%10;          //小数点后第三位
  OLED_Set_Pos(x,y);
  for(j=0;j<6;j++)
    {
      c = number[j] + 16 ;
      for(i=0;i<6;i++)
			{			
				if(j==2)
				{
					OLED_WrDat(F6x8[14][i]);continue;
				}
				OLED_WrDat(F6x8[c][i]);
			}
		}
		lock = 0;
	}	
}

void OLED_ShowCN(unsigned char x, unsigned char y, unsigned char N)
{
	unsigned char wm=0;
	unsigned int  adder=32*N;
	OLED_Set_Pos(x , y);
	for(wm = 0;wm < 16;wm++)
	{
		OLED_WrDat(F16x16[adder]);
		adder += 1;
	}
	OLED_Set_Pos(x,y + 1);
	for(wm = 0;wm < 16;wm++)
	{
		OLED_WrDat(F16x16[adder]);
		adder += 1;
	}
}
void OLED_Show4CN(unsigned char x, unsigned char y)
{
	for(int i=0;i<4;i++)
	{
		OLED_ShowCN(x+i*16-16, y,i);
	}
}

int OLED_printf(uint8_t x,uint8_t y,const char *fmt, ...)
{
    char printf_buf[64];
    va_list args;
    int printed;

    va_start(args, fmt);
    printed = vsprintf(printf_buf, fmt, args);
    va_end(args);
		OLED_P6x8Str(x,y,printf_buf);

	return printed;
}
void OLED_DrawBMP(unsigned char x0,unsigned char y0,unsigned char x1,unsigned char y1,unsigned char BMP[])
{
	unsigned int j=0;
	unsigned char x,y;

  if(y1%8==0)
		y = y1/8;
  else
		y = y1/8 + 1;
	for(y=y0;y<y1;y++)
	{
		OLED_Set_Pos(x0,y);
    for(x=x0;x<x1;x++)
		{
			OLED_WrDat(BMP[j++]);
		}
	}
}
